/*********************************************************************************************************
* 文件名称: UartQue.c
* 文件作者: 深圳大学智能软件模板开发团队
* 当前版本: 01.00.00
* 所属模块: Uart
* 创建日期: 2015年12月11日
* 文件摘要: 
* 注意事项: 
* 更改说明: 初始创建
**********************************************************************************************************/

/*********************************************************************************************************
*                                              包含头文件
*********************************************************************************************************/
#include "UartQue.h"

/*********************************************************************************************************
*                                              变量定义
*********************************************************************************************************/
static u8 sUartRxQueElem[UART_RX_QUE_MAX][UARTRX_QUE_SIZE];
static int sUartRxQuePtr[UART_RX_QUE_MAX];
static int sUartRxQueCount[UART_RX_QUE_MAX];
static u8 sUartTxQueElem[UART_TX_QUE_MAX][UARTTX_QUE_SIZE];
static int sUartTxQuePtr[UART_TX_QUE_MAX];
static int sUartTxQueCount[UART_TX_QUE_MAX];

/*********************************************************************************************************
* 函数名称: InitUartRxCycQue
* 函数功能: 
* 创建日期: 2015年12月11日
* 输入参数: 
* 输出参数: 
* 返 回 值: 
* 注意事项: 
**********************************************************************************************************/
void InitUartRxCycQue( void )
{
	int i;

	for(i=0;i<UART_RX_QUE_MAX;i++)
	{
		sUartRxQuePtr[i] = 0;
		sUartRxQueCount[i] = 0;
	}
}


/*********************************************************************************************************
* 函数名称: ClearUartRxCycQue
* 函数功能: 
* 创建日期: 2015年12月11日
* 输入参数: 
* 输出参数: 
* 返 回 值: 
* 注意事项: 
**********************************************************************************************************/
int ClearUartRxCycQue( int n )
{
	int ok=0;

	if(n>=0 && n < UART_RX_QUE_MAX)
	{
		ok = 1;
		sUartRxQuePtr[n] = 0;
		sUartRxQueCount[n] = 0;
	}
	return ok;
}


/*********************************************************************************************************
* 函数名称: WriteUartRxCycQue
* 函数功能: 
* 创建日期: 2015年12月11日
* 输入参数: 
* 输出参数: 
* 返 回 值: 
* 注意事项: 
**********************************************************************************************************/
int WriteUartRxCycQue( int n, u8 d )
{
	int ok=0;

	if(n>=0 && n < UART_RX_QUE_MAX)
	{
		ok = 1;
		sUartRxQueElem[n][sUartRxQuePtr[n]] = d;
		sUartRxQuePtr[n]++;
		if(sUartRxQuePtr[n] >= UARTRX_QUE_SIZE)
			sUartRxQuePtr[n] = 0;
		if(sUartRxQueCount[n] < UARTRX_QUE_SIZE)
			sUartRxQueCount[n]++;
	}
	return ok;
}


/*********************************************************************************************************
* 函数名称: ReadUartRxCycQue
* 函数功能: 
* 创建日期: 2015年12月11日
* 输入参数: 
* 输出参数: 
* 返 回 值: 
* 注意事项: 
**********************************************************************************************************/
int ReadUartRxCycQue( int n, u8 *p )
{
	int readPtr,ok = 0;

	if(n>=0 && n < UART_RX_QUE_MAX)
	{
		if(sUartRxQueCount[n] > 0)
		{
			ok = 1;
			readPtr = (sUartRxQuePtr[n] - sUartRxQueCount[n] + UARTRX_QUE_SIZE) % UARTRX_QUE_SIZE;
			*p = sUartRxQueElem[n][readPtr];
			sUartRxQueCount[n]--;
		}
	}
	return ok;
}


/*********************************************************************************************************
* 函数名称: CountUartRxCycQue
* 函数功能: 
* 创建日期: 2015年12月11日
* 输入参数: 
* 输出参数: 
* 返 回 值: 
* 注意事项: 
**********************************************************************************************************/
int CountUartRxCycQue( int n )
{
	int count = 0;

	if(n>=0 && n < UART_RX_QUE_MAX)
	{
		count = sUartRxQueCount[n];
	}
	return count;
}


/*********************************************************************************************************
* 函数名称: InitUartTxCycQue
* 函数功能: 
* 创建日期: 2015年12月11日
* 输入参数: 
* 输出参数: 
* 返 回 值: 
* 注意事项: 
**********************************************************************************************************/
void InitUartTxCycQue( void )
{
	int i;

	for(i=0;i<UART_TX_QUE_MAX;i++)
	{
		sUartTxQuePtr[i] = 0;
		sUartTxQueCount[i] = 0;
	}
}


/*********************************************************************************************************
* 函数名称: ClearUartTxCycQue
* 函数功能: 
* 创建日期: 2015年12月11日
* 输入参数: 
* 输出参数: 
* 返 回 值: 
* 注意事项: 
**********************************************************************************************************/
int ClearUartTxCycQue( int n )
{
	int ok=0;

	if(n>=0 && n < UART_TX_QUE_MAX)
	{
		ok = 1;
		sUartTxQuePtr[n] = 0;
		sUartTxQueCount[n] = 0;
	}
	return ok;
}


/*********************************************************************************************************
* 函数名称: WriteUartTxCycQue
* 函数功能: 
* 创建日期: 2015年12月11日
* 输入参数: 
* 输出参数: 
* 返 回 值: 
* 注意事项: 
**********************************************************************************************************/
int WriteUartTxCycQue( int n, u8 d )
{
	int ok=0;

	if(n>=0 && n < UART_TX_QUE_MAX)
	{
		ok = 1;
		sUartTxQueElem[n][sUartTxQuePtr[n]] = d;
		sUartTxQuePtr[n]++;
		if(sUartTxQuePtr[n] >= UARTTX_QUE_SIZE)
			sUartTxQuePtr[n] = 0;
		if(sUartTxQueCount[n] < UARTTX_QUE_SIZE)
			sUartTxQueCount[n]++;
	}
	return ok;
}


/*********************************************************************************************************
* 函数名称: ReadUartTxCycQue
* 函数功能: 
* 创建日期: 2015年12月11日
* 输入参数: 
* 输出参数: 
* 返 回 值: 
* 注意事项: 
**********************************************************************************************************/
int ReadUartTxCycQue( int n, u8 *p )
{
	int readPtr,ok = 0;

	if(n>=0 && n < UART_TX_QUE_MAX)
	{
		if(sUartTxQueCount[n] > 0)
		{
			ok = 1;
			readPtr = (sUartTxQuePtr[n] - sUartTxQueCount[n] + UARTTX_QUE_SIZE) % UARTTX_QUE_SIZE;
			*p = sUartTxQueElem[n][readPtr];
			sUartTxQueCount[n]--;
		}
	}
	return ok;
}


/*********************************************************************************************************
* 函数名称: CountUartTxCycQue
* 函数功能: 
* 创建日期: 2015年12月11日
* 输入参数: 
* 输出参数: 
* 返 回 值: 
* 注意事项: 
**********************************************************************************************************/
int CountUartTxCycQue( int n )
{
	int count = 0;

	if(n>=0 && n < UART_TX_QUE_MAX)
	{
		count = sUartTxQueCount[n];
	}
	return count;
}

